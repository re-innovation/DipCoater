// File generated 10/21/2019 1:30:10 PM
// Warning! This is a generated file, any manual changes will be
// lost during the next generation.

#constant  Strings0Count    0
#constant  Strings0Size     1
// object indexes into ImageControl
#CONST
    iUserled0       // offset 0x0
    iLeddigits0     // offset 0x2800
    iiLeddigits0    // offset 0x5800
    iUserled1       // offset 0xFC00
    iLeddigits1     // offset 0x12400
    iiLeddigits1    // offset 0x15400
    iLeddigits2     // offset 0x1F800
    iiLeddigits2    // offset 0x22800
    iStatictext0    // offset 0x2CC00
    iStatictext1    // offset 0x2DC00
    iStatictext2    // offset 0x2E400
    iStatictext3    // offset 0x2EA00
    iStatictext4    // offset 0x2EE00
    iStatictext5    // offset 0x2F200
    iStatictext6    // offset 0x2F400
    iStatictext7    // offset 0x2FC00
    iStatictext8    // offset 0x30200
    i4Dbutton0      // offset 0x30600
    i4Dbutton1      // offset 0x34800
    i4Dbutton2      // offset 0x38A00
    iUserled2       // offset 0x3CC00
    iUserled3       // offset 0x3E000
    iUserled4       // offset 0x3F400
    iStatictext9    // offset 0x40800
    iUserled5       // offset 0x41400
    iLeddigits3     // offset 0x42800
    iiLeddigits3    // offset 0x46400
    iStatictext10   // offset 0x4F800
    iStatictext11   // offset 0x4FC00
    iStatictext12   // offset 0x4FE00
    iStatictext13   // offset 0x50400
#END

#constant  Strings0StartH   0x0
#constant  Strings0StartL   0x0
#IFNOT EXISTS NOGLOBALS
var hndl ;
#ENDIF
